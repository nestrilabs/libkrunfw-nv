## guest-driver-kernel/Kconfig
```kconfig
config VIRTIO_GPU_NV
	bool "Virtio GPU NV (NVIDIA ioctl proxy)"
	depends on VIRTIO
	default y
	help
	  Virtio device driver that proxies NVIDIA GPU ioctls
	  to the host via the virtio-gpu-nv backend device.
	  This allows unmodified NVIDIA userspace libraries to
	  run inside a microVM.
```

## nvidia-drm-stub/Kconfig
```kconfig
config DRM_NVIDIA_STUB
	tristate "NVIDIA DRM stub for virtio-gpu-nv"
	depends on DRM
	help
	  Minimal DRM driver that registers as "nvidia-drm" to satisfy
	  the NVIDIA Vulkan ICD's device discovery. Used in libkrun VMs
	  with virtio-gpu-nv GPU proxying.
```
